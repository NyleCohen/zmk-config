## config/boards/shields/recluse/Kconfig.defconfig
```kconfig
if SHIELD_RECLUSE_LEFT

config ZMK_KEYBOARD_NAME
    default "recluse"

CONFIG_ZMK_SPLIT_ROLE_CENTRAL=y

endif

if SHIELD_RECLUSE_LEFT || SHIELD_RECLUSE_RIGHT

config ZMK_SPLIT
    default y

endif
```

## config/boards/shields/recluse/Kconfig.shield
```kconfig
config SHIELD_RECLUSE_LEFT
    def_bool $(shields_list_contains,recluse_left)

config SHIELD_RECLUSE_RIGHT
    def_bool $(shields_list_contains,recluse_right)
```
